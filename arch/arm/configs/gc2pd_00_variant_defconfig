## drivers/gpu/mali400/Kconfig
```kconfig
menuconfig MALI400
	tristate "Mali-300/400/450 support (R3P2/R4P0)"
	depends on ARM
	default y
	---help---
	  This enables support for the ARM Mali-300, Mali-400, and Mali-450
	  GPUs.

	  To compile this driver as a module, choose M here: the module will be
	  called mali.

choice
depends on MALI400
prompt "Select MALI VER"
default MALI_VER_R3P2
config MALI_VER_R3P2
	bool "Mali400 Version R3P2"
	help
	  Choose this option to select DDK version.

if MALI_VER_R3P2
source "drivers/gpu/mali400/r3p2/mali/Kconfig"
source "drivers/gpu/mali400/r3p2/ump/Kconfig"
endif

config MALI_VER_R4P0
	bool "Mali400 Version R4P0"
	select DMA_SHARED_BUFFER
	help
	  Choose this option to select DDK version.

if MALI_VER_R4P0
source "drivers/gpu/mali400/r4p0/mali/Kconfig"
source "drivers/gpu/mali400/r4p0/ump/Kconfig"
endif

endchoice
```

## drivers/gpu/mali400/r3p2/mali/Kconfig
```kconfig
config MALI400_DEBUG
	bool "Enable debug in Mali driver"
	depends on MALI400
	---help---
	  This enabled extra debug checks and messages in the Mali driver.

config MALI400_PROFILING
	bool "Enable Mali profiling"
	depends on MALI400
	select TRACEPOINTS
	default n
	---help---
	  This enables gator profiling of Mali GPU events.

config MALI400_INTERNAL_PROFILING
	bool "Enable internal Mali profiling API"
	depends on MALI400_PROFILING
	default n
	---help---
	  This enables the internal legacy Mali profiling API.
	  
if CPU_EXYNOS4212 || CPU_EXYNOS4412
config MALI_DVFS
	bool "Enable mali DVFS"
	depends on MALI400 && PM
	default y
	---help---
		This enables Mali driver DVFS.
endif

if SOC_EXYNOS3470
config MALI_DVFS
	bool "Enable mali DVFS"
	depends on MALI400 && PM_DEVFREQ
	default y
	---help---
		This enables Mali driver DVFS.
endif

if CPU_EXYNOS4212 || CPU_EXYNOS4412
config MALI400_UMP
	bool "Enable UMP support"
	depends on MALI400
	default y
	---help---
	  This enables support for the UMP memory sharing API in the Mali driver.
endif

config MALI_DMA_BUF_MAP_ON_ATTACH
	bool "Map dma-buf attachments on attach"
	depends on MALI400 && DMA_SHARED_BUFFER
	default y
	---help---
	  This makes the Mali driver map dma-buf attachments after doing
	  attach. If this is not set the dma-buf attachments will be mapped for
	  every time the GPU need to access the buffer.

	  Mapping for each access can cause lower performance.

config MALI_SHARED_INTERRUPTS
	bool "Support for shared interrupts"
	depends on MALI400
	default n
	---help---
	  Adds functionality required to properly support shared interrupts.  Without this support,
	  the device driver will fail during insmod if it detects shared interrupts.  Works even if
	  the GPU is not using shared interrupts, but can cause lower performance.

config GPU_CLOCK_CONTROL
  bool "Enable GPU clock control and voltage interface"
  depends on MALI400
  default y
  help
    This enables a sysfs interface to control gpu clock and voltage.

choice
depends on MALI400 && MALI_VER_R3P2
prompt "Select MALI400 R3P2 Blobs version"
default MALI_R3P2_REL_3_API_23

config MALI_R3P2_REL_3_API_23
	bool "Support MALI R3P2 rel 3 blobs (API 23)"
	help
	  This enables support for SAMSUNG MALI R3P2 rel3 blobs shipped with SAMSUNG 4.3.0 to 4.4.2 roms

config MALI_R3P2_REL_3_API_29
	bool "Support MALI R3P2 rel 3 blobs (API 29)"
	help
	  This enables support for SAMSUNG MALI R3P2 rel3 blobs shipped with SAMSUNG 4.4.4 roms
 
endchoice

config MALI_R3P2_REL_3_API_SKIP_COMPATIBILITY_CHECKING
	bool "IGNORE MALI R3P2 rel 3 blobs API COMPATIBILITY CHECK"
	help
	  This disables the MALI API checking and assumes compatibility, thereby not resorting to black screen
	  if incompatible blobs are used.  (Use with caution !)
```

## drivers/staging/lz4/Kconfig
```kconfig
config LZ4_COMPRESS
	tristate "LZ4 Compressoion"
	default n

config LZ4_DECOMPRESS
	tristate "LZ4 Decompression"
	default n
```

## drivers/staging/snappy/Kconfig
```kconfig
config SNAPPY_COMPRESS
	tristate "Snappy Compression"
	default Y
	help
		Snappy is a compressionlibrary.
		It does not aim for maximum compression, or compatibility  with any other
		compression library; instead, it aims for very high speeds and reasonable
		compression.  Compared to the fastest mode of zlib, Snappy is an order of 
		magnitude  faster  for most inputs,  but the resulting files are anywhere 
		from 20% to 100% bigger.

config SNAPPY_DECOMPRESS
	tristate "Snappy Decompression"
	default Y
	help
		Snappy is a decompression library.
		It does not aim for compatibility with any other compression library; instead
		it aims for very high speeds.  Compared to the fastest mode ofzlib, Snappy is
		two order of magnitude faster for most compressed inputs. 
```

## fs/exfat/Kconfig
```kconfig
config EXFAT_FS
	tristate "SAMSUNG OPEN-SOURCED exFAT Kernel Module"
	default m
	help
	  exFAT (Extended File Allocation Table) is a Microsoft file system optimized for flash drives. It is proprietary and patent-pending. It is 		  supported in Windows XP and Windows Server 2003 with update KB955704, Windows Embedded CE 6.0, Windows Vista with Service Pack 1, 		  Windows Server 2008, Windows 7, Windows 8, Windows Server 2008 R2 (except Windows Server 2008 Server Core), Mac OS X Snow Leopard starting 		  from 10.6.5, Mac OS X Lion and OS X Mountain Lion. exFAT can be used where the NTFS file system is not a feasible solution, due to data 		  structure overhead, or where the file size limit of the standard FAT32 file system (that is, without FAT32+ extension) is unacceptable.
	  Unlike NTFS, exFAT cannot pre-allocate disk space for a file by just marking arbitrary space on disk as 'allocated'. As in FAT, when 		  creating a file of known length, exFAT must perform a complete physical write equal to the size of the file.
	  exFAT is also supported in a number of media devices such as modern flat panel TVs, media centers, and portable media players

	  To compile this file system support select as a module only, choose M here. The modules will be called exfat_core.ko and exfat_fs.ko
```

## fs/sdcardfsjb/Kconfig
```kconfig
config SDCARD_FS_JB
	tristate "sdcard file system (Android 4.3)"
	depends on EXPERIMENTAL && SDCARD_FS
	default y
	help
	  sdcardfsjb is a sdcardfs for Android 4.3 KitKat
```

## fs/sdcardfskk/Kconfig
```kconfig
config SDCARD_FS_KK
	tristate "sdcard file system (Android 4.4+)"
	depends on EXPERIMENTAL && SDCARD_FS
	default y
	help
	  sdcardfskk is a sdcardfs dedicated for Android 4.4 KitKat
```

## fs/sdcardfslp/Kconfig
```kconfig
config SDCARD_FS_LP
	tristate "sdcard file system"
	depends on EXPERIMENTAL && SDCARD_FS
	default y
	help
	  sdcardfslp is a sdcardfs dedicated for Android 5.x
```

## net/netfilter/interceptor/Kconfig
```kconfig
config INSIDESECURE_VPNCLIENT
       bool "InsideSecure VPNClient Interceptor"
       default y
```
